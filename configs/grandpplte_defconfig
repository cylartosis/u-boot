## configs/grandpplte_defconfig
```kconfig
CONFIG_ARM=y
CONFIG_POSITION_INDEPENDENT=y
CONFIG_ARCH_MEDIATEK=y
CONFIG_SYS_TEXT_BASE=0x40080000
CONFIG_SYS_MALLOC_LEN=0x2000000
CONFIG_SYS_MALLOC_F_LEN=0x8000
CONFIG_NR_DRAM_BANKS=1
CONFIG_ENV_SIZE=0x1000
CONFIG_DM_GPIO=y
CONFIG_DEFAULT_DEVICE_TREE="mt6737t-samsung-grandpplte"
CONFIG_SYS_PROMPT="MT6735->"
# CONFIG_PSCI_RESET is not set
CONFIG_SYS_LOAD_ADDR=0x40080000
CONFIG_CC_OPTIMIZE_FOR_SPEED=y
# CONFIG_EXPERT is not set
CONFIG_STACK_SIZE=0x0
# CONFIG_ANDROID_BOOT_IMAGE is not set
CONFIG_FIT=y
# CONFIG_BOOTMETH_DISTRO is not set
CONFIG_SUPPORT_RAW_INITRD=y
CONFIG_SD_BOOT=y
CONFIG_BOOTDELAY=0
CONFIG_AUTOBOOT_KEYED=y
CONFIG_AUTOBOOT_STOP_STR="KEY_DOWN"
CONFIG_USE_BOOTCOMMAND=y
CONFIG_BOOTCOMMAND="source 0x44000000:bootscript"
CONFIG_DEFAULT_FDT_FILE="mt6737t-samsung-grandpplte.dtb"
CONFIG_LOGLEVEL=9
CONFIG_SYS_STDIO_DEREGISTER=y
CONFIG_LOG=y
CONFIG_EVENT=y
CONFIG_EVENT_DYNAMIC=y
CONFIG_CMD_BOOTZ=y
CONFIG_CMD_BOOTMENU=y
CONFIG_CMD_GREPENV=y
CONFIG_CMD_ERASEENV=y
CONFIG_CMD_ENV_CALLBACK=y
CONFIG_CMD_ENV_FLAGS=y
CONFIG_CMD_NVEDIT_INFO=y
CONFIG_CMD_NVEDIT_LOAD=y
CONFIG_CMD_NVEDIT_SELECT=y
CONFIG_CMD_MEMINFO=y
CONFIG_CMD_MEM_SEARCH=y
CONFIG_CMD_MEMTEST=y
CONFIG_CMD_BIND=y
CONFIG_CMD_CLK=y
CONFIG_CMD_DM=y
CONFIG_CMD_GPT=y
# CONFIG_RANDOM_UUID is not set
CONFIG_CMD_LSBLK=y
CONFIG_CMD_MMC=y
CONFIG_CMD_BKOPS_ENABLE=y
CONFIG_CMD_MMC_SWRITE=y
CONFIG_CMD_PART=y
CONFIG_CMD_READ=y
CONFIG_CMD_SDRAM=y
CONFIG_CMD_AXI=y
# CONFIG_CMD_DATE is not set
CONFIG_CMD_PMIC=y
CONFIG_CMD_REGULATOR=y
CONFIG_CMD_EXT4=y
CONFIG_DOS_PARTITION=y
# CONFIG_NET is not set
# CONFIG_DM_WARN is not set
CONFIG_DM_EVENT=y
CONFIG_REGMAP=y
CONFIG_SYSCON=y
CONFIG_DEVRES=y
CONFIG_DEBUG_DEVRES=y
CONFIG_AXI=y
CONFIG_CLK=y
CONFIG_USB_FUNCTION_FASTBOOT=y
CONFIG_FASTBOOT_BUF_ADDR=0x41000000
CONFIG_FIRMWARE=y
# CONFIG_I2C is not set
CONFIG_DM_KEYBOARD=y
# CONFIG_MMC_QUIRKS is not set
CONFIG_MMC_IO_VOLTAGE=y
CONFIG_MMC_UHS_SUPPORT=y
CONFIG_MMC_HS400_ES_SUPPORT=y
CONFIG_MMC_HS400_SUPPORT=y
CONFIG_MMC_MTK=y
CONFIG_PHY=y
CONFIG_PHY_MTK_TPHY=y
CONFIG_PINCTRL=y
CONFIG_PINCONF=y
CONFIG_PWRAP=y
CONFIG_MT6735_PWRAP=y
CONFIG_POWER_DOMAIN=y
CONFIG_MTK_POWER_DOMAIN=y
CONFIG_DM_PMIC=y
CONFIG_PMIC_MT6328=y
CONFIG_DM_REGULATOR=y
CONFIG_DM_REGULATOR_MT6328=y
CONFIG_DM_REGULATOR_FIXED=y
CONFIG_POWER_MT6328=y
CONFIG_DM_PWM=y
CONFIG_PWM_MTK=y
CONFIG_RAM=y
CONFIG_DM_RESET=y
CONFIG_DM_RTC=y
CONFIG_RTC_MT6328=y
CONFIG_DM_SERIAL=y
CONFIG_MTK_SERIAL=y
CONFIG_USB=y
CONFIG_DM_USB_GADGET=y
CONFIG_USB_MUSB_GADGET=y
CONFIG_USB_MUSB_MT6735=y
CONFIG_USB_MUSB_PIO_ONLY=y
CONFIG_USB_GADGET=y
CONFIG_USB_GADGET_VENDOR_NUM=0x0e8d
CONFIG_USB_GADGET_PRODUCT_NUM=0x201c
CONFIG_USB_FUNCTION_MASS_STORAGE=y
CONFIG_USB_FUNCTION_SDP=y
CONFIG_WDT=y
CONFIG_EXT4_WRITE=y
CONFIG_FS_FAT=y
CONFIG_FAT_WRITE=y
CONFIG_FS_SQUASHFS=y
CONFIG_REGEX=y
CONFIG_LZO=y
CONFIG_ZSTD=y
# CONFIG_EFI_LOADER is not set
CONFIG_LMB_MAX_REGIONS=16
```

## configs/mt6735_defconfig
```kconfig
CONFIG_ARM=y
CONFIG_SYS_BOARD="mt6735"
CONFIG_SYS_CONFIG_NAME="mt6735"
CONFIG_POSITION_INDEPENDENT=y
CONFIG_ARCH_MEDIATEK=y
CONFIG_SYS_TEXT_BASE=0x40080000
CONFIG_SYS_MALLOC_LEN=0x2000000
CONFIG_SYS_MALLOC_F_LEN=0x8000
CONFIG_SPL_GPIO=y
CONFIG_NR_DRAM_BANKS=1
CONFIG_ENV_SIZE=0x1000
CONFIG_DM_GPIO=y
CONFIG_DEFAULT_DEVICE_TREE="mt6735-test"
CONFIG_SPL_TEXT_BASE=0x201000
CONFIG_SPL_MMC=y
CONFIG_SPL_SERIAL=y
CONFIG_SPL_STACK_R_ADDR=0x40800000
# CONFIG_PSCI_RESET is not set
CONFIG_SYS_LOAD_ADDR=0x40080000
CONFIG_STACK_SIZE=0x0
CONFIG_ANDROID_BOOT_IMAGE=y
CONFIG_SUPPORT_RAW_INITRD=y
CONFIG_SD_BOOT=y
CONFIG_BOOTDELAY=8
CONFIG_AUTOBOOT_KEYED=y
CONFIG_AUTOBOOT_STOP_STR="KEY_DOWN"
CONFIG_AUTOBOOT_MENU_SHOW=y
CONFIG_USE_BOOTCOMMAND=y
CONFIG_DEFAULT_FDT_FILE="mt6735-test.dtb"
CONFIG_LOGLEVEL=9
CONFIG_SYS_STDIO_DEREGISTER=y
CONFIG_LOG=y
CONFIG_SPL_SYS_MALLOC_SIMPLE=y
CONFIG_SPL_STACK_R=y
CONFIG_SYS_MMCSD_RAW_MODE_U_BOOT_USE_SECTOR=y
CONFIG_SYS_MMCSD_RAW_MODE_U_BOOT_SECTOR=0x40
CONFIG_SYS_MMCSD_RAW_MODE_U_BOOT_DATA_PART_OFFSET=0x10
CONFIG_SPL_MUSB_NEW=y
CONFIG_SPL_DM_RESET=y
CONFIG_SPL_POWER_DOMAIN=y
CONFIG_SPL_RTC=y
CONFIG_SPL_USB_GADGET=y
CONFIG_SPL_USB_SDP_SUPPORT=y
CONFIG_SPL_WATCHDOG=y
CONFIG_SYS_PROMPT="MT6735->"
CONFIG_CMD_BOOTZ=y
CONFIG_CMD_BOOTMENU=y
CONFIG_CMD_ERASEENV=y
CONFIG_CMD_ENV_CALLBACK=y
CONFIG_CMD_ENV_FLAGS=y
CONFIG_CMD_NVEDIT_INFO=y
CONFIG_CMD_NVEDIT_LOAD=y
CONFIG_CMD_NVEDIT_SELECT=y
CONFIG_CMD_MEMINFO=y
CONFIG_CMD_MEM_SEARCH=y
CONFIG_CMD_MEMTEST=y
CONFIG_CMD_BIND=y
CONFIG_CMD_CLK=y
CONFIG_CMD_DM=y
CONFIG_CMD_LSBLK=y
CONFIG_CMD_MMC=y
CONFIG_CMD_BKOPS_ENABLE=y
CONFIG_CMD_MMC_SWRITE=y
CONFIG_CMD_SDRAM=y
CONFIG_CMD_WDT=y
CONFIG_CMD_AXI=y
# CONFIG_CMD_DATE is not set
CONFIG_CMD_PMIC=y
CONFIG_CMD_REGULATOR=y
CONFIG_DOS_PARTITION=y
CONFIG_OF_SPL_REMOVE_PROPS="pinctrl-0 pinctrl-names clocks clock-names interrupt-parent interrupts"
# CONFIG_NET is not set
CONFIG_REGMAP=y
CONFIG_SPL_REGMAP=y
CONFIG_SYSCON=y
CONFIG_SPL_SYSCON=y
CONFIG_DEVRES=y
CONFIG_DEBUG_DEVRES=y
CONFIG_AXI=y
CONFIG_CLK=y
CONFIG_SPL_CLK=y
CONFIG_FIRMWARE=y
# CONFIG_I2C is not set
CONFIG_DM_KEYBOARD=y
# CONFIG_MMC_QUIRKS is not set
CONFIG_MMC_IO_VOLTAGE=y
CONFIG_MMC_UHS_SUPPORT=y
CONFIG_MMC_HS400_ES_SUPPORT=y
CONFIG_MMC_HS400_SUPPORT=y
CONFIG_SPL_MMC_HS400_SUPPORT=y
CONFIG_MMC_TRACE=y
CONFIG_MMC_MTK=y
CONFIG_PHY=y
CONFIG_SPL_PHY=y
CONFIG_PHY_MTK_TPHY=y
CONFIG_PINCTRL=y
CONFIG_PINCONF=y
CONFIG_SPL_PINCTRL=y
CONFIG_SPL_PINCONF=y
CONFIG_PINCTRL_MT6735=y
CONFIG_PWRAP=y
CONFIG_MT6735_PWRAP=y
CONFIG_POWER_DOMAIN=y
CONFIG_MTK_POWER_DOMAIN=y
CONFIG_DM_PMIC=y
CONFIG_PMIC_MT6328=y
CONFIG_DM_REGULATOR=y
CONFIG_SPL_DM_REGULATOR=y
CONFIG_DM_REGULATOR_MT6328=y
CONFIG_DM_REGULATOR_FIXED=y
CONFIG_SPL_DM_REGULATOR_FIXED=y
CONFIG_POWER_MT6328=y
CONFIG_DM_PWM=y
CONFIG_PWM_MTK=y
CONFIG_RAM=y
CONFIG_SPL_RAM=y
CONFIG_DM_RTC=y
CONFIG_SPL_DM_RTC=y
CONFIG_RTC_MT6328=y
CONFIG_DM_SERIAL=y
CONFIG_MTK_SERIAL=y
CONFIG_SYSRESET=y
CONFIG_SPL_SYSRESET=y
CONFIG_SYSRESET_WATCHDOG=y
CONFIG_SYSRESET_RESETCTL=y
CONFIG_TIMER=y
CONFIG_SPL_TIMER=y
CONFIG_MTK_TIMER=y
CONFIG_USB=y
CONFIG_DM_USB_GADGET=y
CONFIG_SPL_DM_USB_GADGET=y
CONFIG_USB_MUSB_GADGET=y
CONFIG_USB_MUSB_MT6735=y
CONFIG_USB_MUSB_PIO_ONLY=y
CONFIG_USB_GADGET=y
CONFIG_USB_GADGET_VENDOR_NUM=0x0e8d
CONFIG_USB_GADGET_PRODUCT_NUM=0x201c
CONFIG_USB_GADGET_DOWNLOAD=y
CONFIG_USB_FUNCTION_MASS_STORAGE=y
CONFIG_USB_FUNCTION_SDP=y
CONFIG_WDT_MTK=y
CONFIG_FS_EXT4=y
CONFIG_EXT4_WRITE=y
CONFIG_FS_FAT=y
CONFIG_FS_SQUASHFS=y
CONFIG_SHA256=y
CONFIG_LZO=y
CONFIG_ZSTD=y
CONFIG_PHANDLE_CHECK_SEQ=y
```
